## zephyr/Kconfig
```kconfig
menu "CryptoAuthLib Configuration"

config CRYPTOAUTHLIB
	bool "Enable CryptoAuthLib"
	default n
	help
	  Master switch for the CryptoAuthLib module.

menu "Hardware Abstraction Layer (HAL)"

config ATCA_HAL_I2C
	bool "Enable I2C HAL driver"
	default y
	help
	  Use the I2C HAL (Linux & MCU) for device communication.

config ATCA_HAL_SPI
	bool "Enable SPI HAL driver"
	default n
	help
	  Use the SPI HAL (Linux & MCU) for device communication.

config ATCA_HAL_CUSTOM
	bool "Enable custom/plug-in HAL driver"
	default n
	help
	  Build support for a custom HAL implementation.

config ATCA_HAL_KIT_HID
	bool "Enable KIT HID HAL driver"
	default n
	help
	  Include the HID-based kit protocol driver.

config ATCA_HAL_KIT_BRIDGE
	bool "Enable KIT Bridge protocol"
	default n
	help
	  Include the general-purpose KIT bridge protocol.

config ATCA_HAL_KIT_UART
	bool "Enable KIT UART HAL driver"
	default n
	help
	  Include the UART-based kit protocol driver.

config ATCA_HAL_SWI_UART
	bool "Enable SWI-UART HAL driver"
	default n
	help
	  Include the single-wire interface over UART driver.

endmenu # HAL

menu "Library Behavior Options"

config ATCA_PRINTF
	bool "Enable debug printf statements"
	default n
	help
	  Turn on internal debug printfs in the library.

config ATCA_NO_HEAP
	bool "Disable dynamic heap allocation"
	default y
	help
	  Do not use malloc/free; use only stack/static allocations.

config ATCA_CHECK_PARAMS_EN
	bool "Enable parameter checking"
	default y
	help
	  Check input parameters in public APIs for safety.

config ATCA_ENABLE_DEPRECATED
	bool "Enable deprecated APIs"
	default n
	help
	  Allow use of older API wrappers that have been replaced.

config ATCA_STRICT_C99
	bool "Enable strict C99 compliance"
	default n
	help
	  Compile with strict C99 rules (-Wpedantic).

config MULTIPART_BUF_EN
	bool "Enable multipart buffer support"
	default n
	help
	  Support large multipart buffers in CryptoAuthLib.

endmenu # Library Behavior

menu "Cryptographic Backends"

config ATCA_MBEDTLS
	bool "Enable mbedTLS integration"
	default n

config ATCA_WOLFSSL
	bool "Enable WolfSSL integration"
	default n

config ATCA_OPENSSL
	bool "Enable OpenSSL integration"
	default n

endmenu # Crypto Backends

menu "Certificate and JWT Options"

config ATCA_JWT_EN
	bool "Enable JWT functionality"
	default n
	help
	  Build in support for JSON Web Tokens.

config ATCACERT_COMPCERT_EN
	bool "Enable compressed certificate support"
	default y

config ATCACERT_FULLSTOREDCERT_EN
	bool "Enable full certificate support"
	default y

menu "Trust Platform (TNG) Certificates"

config ATCA_TNGTLS_SUPPORT
	bool "Enable Trust & Go TLS certs"
	default n

config ATCA_TNGLORA_SUPPORT
	bool "Enable Trust & Go LoRa certs"
	default n

config ATCA_TFLEX_SUPPORT
	bool "Enable TrustFlex certificates"
	default n

config ATCA_TNG_LEGACY_SUPPORT
	bool "Enable legacy Trust & Go certs"
	default n

endmenu # TNG

config ATCA_WPC_SUPPORT
	bool "Enable WPC Certificates"
	default n

endmenu # Certificate and JWT

menu "SHA Support"

config ATCAC_SHA384_EN
	bool "Enable SHA-384 support"
	default n

config ATCAC_SHA512_EN
	bool "Enable SHA-512 support"
	default n

endmenu # SHA Support

menu "PKCS11 Support"

config ATCA_PKCS11
	bool "Enable PKCS#11 library"
	default n
	help
	  Build the PKCS#11 interface (Linux & Zephyr only).

endmenu # PKCS11

menu "Supported Devices"

config ATCA_ATSHA204A_SUPPORT
	bool "Support ATSHA204A device"
	default y

config ATCA_ATSHA206A_SUPPORT
	bool "Support ATSHA206A device"
	default y

config ATCA_ATECC108A_SUPPORT
	bool "Support ATECC108A device"
	default y

config ATCA_ATECC508A_SUPPORT
	bool "Support ATECC508A device"
	default y

config ATCA_ATECC608_SUPPORT
	bool "Support ATECC608 device"
	default y

config ATCA_ECC204_SUPPORT
	bool "Support ECC204 device"
	default y

config ATCA_TA010_SUPPORT
	bool "Support TA010 device"
	default y

config ATCA_SHA104_SUPPORT
	bool "Support SHA104 device"
	default y

config ATCA_SHA105_SUPPORT
	bool "Support SHA105 device"
	default y

endmenu # Devices

endmenu # CryptoAuthLib Configuration
```
